## linux-2.6.21.x/net/nat/hw_nat/Kconfig
```kconfig
choice
        prompt "Binding Method"
	depends on RA_HW_NAT
	default RA_HW_NAT_MANUAL_BIND

config  RA_HW_NAT_AUTO_BIND
        bool "Auto"
	depends on RA_HW_NAT

config  RA_HW_NAT_SEMIAUTO_BIND
        bool "Semi-Auto"
	depends on RA_HW_NAT

config  RA_HW_NAT_MANUAL_BIND
        bool "Manual"
	depends on RA_HW_NAT

endchoice


config  RA_HW_NAT_BINDING_THRESHOLD
        int "Binding Threshold (Unit:Packet Per Second)"
	depends on RA_HW_NAT
	default 30

config  RA_HW_NAT_QURT_LMT
        int "Max entries allowed build when FreeEntries>3/4 (MUST <16384)"
	depends on RA_HW_NAT
	default 100

config  RA_HW_NAT_HALF_LMT
        int "Max entries allowed build when FreeEntries>1/2 (MUST <16384)"
	depends on RA_HW_NAT
	default 50


config  RA_HW_NAT_FULL_LMT
        int "Max entries allowed build when FreeEntries<1/2 (MUST <16384)"
	depends on RA_HW_NAT
	default 25

choice
        prompt "Foe Table Size"
	depends on RA_HW_NAT
	default RA_HW_NAT_TBL_4K

config  RA_HW_NAT_TBL_1K
        bool "1K"
	depends on RA_HW_NAT

config  RA_HW_NAT_TBL_2K
        bool "2K"
	depends on RA_HW_NAT

config  RA_HW_NAT_TBL_4K
        bool "4K"
	depends on RA_HW_NAT

config  RA_HW_NAT_TBL_8K
        bool "8K"
	depends on RA_HW_NAT

config  RA_HW_NAT_TBL_16K
        bool "16K"
	depends on RA_HW_NAT
	
endchoice


choice
	prompt "Hash Algorithm"
	depends on RA_HW_NAT
	default RA_HW_NAT_HASH1
	
config  RA_HW_NAT_HASH0
        bool "Hash0-Simple"
	depends on RA_HW_NAT

config  RA_HW_NAT_HASH1
        bool "Hash1-Complex"
	depends on RA_HW_NAT

endchoice

config  RA_HW_NAT_PRE_ACL_SIZE
        int "Pre ACL Table Size"
	depends on RA_HW_NAT
	default 112

config  RA_HW_NAT_PRE_MTR_SIZE
        int "Pre Meter Table Size"
	depends on RA_HW_NAT
	default 100

config  RA_HW_NAT_PRE_AC_SIZE
        int "Pre AC Table Size"
	depends on RA_HW_NAT
	default 100

config  RA_HW_NAT_POST_MTR_SIZE
        int "Post Meter Table Size"
	depends on RA_HW_NAT
	default 100

config  RA_HW_NAT_POST_AC_SIZE
        int "Post AC Table Size"
	depends on RA_HW_NAT
	default 100


config  RA_HW_NAT_TCP_KA
        int "TCP KeepAlive Interval(Unit:1Sec)"
	depends on RA_HW_NAT_TBL_1K
	default 5

config  RA_HW_NAT_UDP_KA
        int "UDP KeepAlive Interval(Unit:1Sec)"
	depends on RA_HW_NAT_TBL_1K
	default 5

config  RA_HW_NAT_TCP_KA
        int "TCP KeepAlive Interval(Unit:2Sec)"
	depends on RA_HW_NAT_TBL_2K
	default 3

config  RA_HW_NAT_UDP_KA
        int "UDP KeepAlive Interval(Unit:2Sec)"
	depends on RA_HW_NAT_TBL_2K
	default 3

config  RA_HW_NAT_TCP_KA
        int "TCP KeepAlive Interval(Unit:4Sec)"
	depends on RA_HW_NAT_TBL_4K
	default 1

config  RA_HW_NAT_UDP_KA
        int "UDP KeepAlive Interval(Unit:4Sec)"
	depends on RA_HW_NAT_TBL_4K
	default 1

config  RA_HW_NAT_TCP_KA
        int "TCP KeepAlive Interval(Unit:8Sec)"
	depends on RA_HW_NAT_TBL_8K
	default 1

config  RA_HW_NAT_UDP_KA
        int "UDP KeepAlive Interval(Unit:8Sec)"
	depends on RA_HW_NAT_TBL_8K
	default 1

config  RA_HW_NAT_TCP_KA
        int "TCP KeepAlive Interval(Unit:16Sec)"
	depends on RA_HW_NAT_TBL_16K
	default 1

config  RA_HW_NAT_UDP_KA
        int "UDP KeepAlive Interval(Unit:16Sec)"
	depends on RA_HW_NAT_TBL_16K
	default 1

config  RA_HW_NAT_UNB_MNP
        int "Min threshold for unbind state(Pkt count)"
	depends on RA_HW_NAT
	default 1000

config  RA_HW_NAT_ACL_DLTA
        int "Life time of ACL link to FOE entry(Unit:1Sec)"
	depends on RA_HW_NAT
	default 3

config  RA_HW_NAT_UNB_DLTA
        int "Life time of Unbind entry (Unit:1Sec)"
	depends on RA_HW_NAT
	default 3

config  RA_HW_NAT_UDP_DLTA
        int "Life time of Bind UDP entry (Unit:1Sec)"
	depends on RA_HW_NAT
	default 5

config  RA_HW_NAT_TCP_DLTA
        int "Life time of Bind TCP entry (Unit:1Sec)"
	depends on RA_HW_NAT
	default 5

config  RA_HW_NAT_FIN_DLTA
        int "Life time of Bind FIN entry (Unit:1Sec)"
	depends on RA_HW_NAT
	default 5
	
config  RA_HW_NAT_WLAN_NAME
        string "WLAN"
	depends on RA_HW_NAT
	default "ra0"

config  RA_HW_NAT_PCI_NAME
        string "PCI"
	depends on RA_HW_NAT
	default "eth0"

config  RA_HW_NAT_GMAC_NAME
        string "GMAC"
	depends on RA_HW_NAT
	default "eth2"
```

## linux-2.6.21.x/ralink/Kconfig
```kconfig
menu "Ralink Module"

###########
# Product ID
###########
config RT_FULL_DEVICE_NAME
        string "Original device name"
        default "Wive WR-NL"


###########
# Debuging
###########
source "drivers/net/rt_rdm/Kconfig"

#############
# Wire
#############
menu "Ethernet Ralink RT3xx/RT28xx wire driver."
source "drivers/net/raeth/Kconfig"
endmenu

#############
# Wireless
#############
menu "Platform config for  Ralink RT3xx/RT28xx/RT5xx."

config RALINK_RT3052_25DRIVER
	bool "Use old 2.5.0.x version AP driver for RT305x/3350"
        depends on RALINK_RT3052

choice
        prompt "RF Type"
        depends on RALINK_RT5350
        default RALINK_RT5350_1T1R
        config  RALINK_RT5350_1T1R
        bool "1T1R"
endchoice

choice
        prompt "RF Type"
        depends on RALINK_RT3052
        default RALINK_RT3052_2T2R

        config  RALINK_RT3050_1T1R
        bool "1T1R"

        config  RALINK_RT3051_1T2R
        bool "1T2R"

        config  RALINK_RT3052_2T2R
        bool "2T2R"
endchoice

choice
        prompt "RF Type"
        depends on  RALINK_RT3352

        config  RALINK_RT3352_2T2R
        bool "2T2R"
endchoice

choice
	prompt "RF Type"
	depends on RALINK_RT3883

	config  RALINK_RT3662_2T2R
	bool "2T3R (RT3662)"

	config  RALINK_RT3883_3T3R
	bool "3T3R (RT3883)"
endchoice
endmenu

menu "Nat acell mode"
choice
        prompt "Hardware nat mode"

config  RA_NAT_HW
        bool "Hardware NAT acceleration"

config RA_NAT_NONE
        bool "Disable NAT acceleration"
endchoice

#######
# PPE
#######
if RA_NAT_HW
menu "Ralink RT3xx/RT28xx NAT Acell support."
source "net/nat/hw_nat/Kconfig"
endmenu
endif
endmenu

#######
# Fastpath
#######
source "net/nat/bcm_nat/Kconfig"

#######
# WIFI
#######
menu "AP(STA) MODE Ralink RT3xxx wireless driver."
source "drivers/net/wireless/ralink/rt3xxx/rt2860v2_ap/Kconfig"
source "drivers/net/wireless/ralink/rt3xxx/rt2860v2_sta/Kconfig"
if HW_HAS_PCI
    menu "802.11 309x AP pci-e wireless driver."
    source "drivers/net/wireless/ralink/rt3090/rt3090_ap/Kconfig"
    endmenu
endif
endmenu

menu "Ralink DEVICES."
config RTDEV_USB
bool
default y if RT305x_INIC_USB || RT3572_AP

config RTDEV_MII
bool
default y if RT2880v2_INIC_MII || RT305x_INIC_MII

config RTDEV_PCI
bool
default y if RT2880v2_INIC_PCI || RT3090_AP
endmenu

#######
# USB
#######
config RT3XXX_EHCI_OHCI
	bool "Ralink USB EHCI/OHCI controller support"
        depends on (RALINK_RT3883 || RALINK_RT3352)
	select USB_ARCH_HAS_OHCI
	select USB_ARCH_HAS_EHCI

source "drivers/usb/dwc_otg/Kconfig"

endmenu
```
