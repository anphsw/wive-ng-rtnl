## config.in
```kconfig
mainmenu_name 'Wive-NG Embedded Linux Configuration'
mainmenu_option next_comment
comment 'Select the Product you wish to target'
choice 'Ralink Products' "RT3052 CONFIG_DEFAULTS_RALINK_RT3052\
                         "
choice   'Flash/SDRAM Size'\
         "4M/32M(AP+STA)		  CONFIG_DEFSETTING_4M32M\
           8M/32M(AP+STA+NAS)       CONFIG_DEFSETTING_8M32M 
	  	"
endmenu
define_string CONFIG_VENDOR "Ralink"
mainmenu_option next_comment
comment 'Kernel/Library/Defaults Selection'
define_bool CONFIG_DEFAULTS_KERNEL_2_6_21 y
string 'Cross Compiler Path' 			CONFIG_CROSS_COMPILER_PATH /opt/Wive-RTNL/toolchain/bin
comment ' '
bool 'Default all settings (lose changes)'	CONFIG_DEFAULTS_OVERRIDE
bool 'Customize Kernel Settings'		CONFIG_DEFAULTS_KERNEL
bool 'Customize Vendor/User Settings'		CONFIG_DEFAULTS_VENDOR
bool 'Customize Busybox Settings'               CONFIG_DEFAULTS_BUSYBOX
bool 'Customize uClibc Settings'                CONFIG_DEFAULTS_UCLIBC
bool 'Update Default Vendor Settings'		CONFIG_DEFAULTS_VENDOR_UPDATE
endmenu
```

## linux-2.6.21.x/arch/mips/oprofile/Kconfig
```kconfig
menu "Profiling support"

config PROFILING
	bool "Profiling support"
	default n
	help
	  Say Y here to enable the extended profiling support mechanisms used
	  by profilers such as OProfile.


config OPROFILE
	tristate "OProfile system profiling"
	default n
	depends on PROFILING && !MIPS_MT_SMTC
	help
	  OProfile is a profiling system capable of profiling the
	  whole system, include the kernel, kernel modules, libraries,
	  and applications.

	  If unsure, say N.

endmenu
```

## linux-2.6.21.x/drivers/net/raeth/Kconfig
```kconfig
config RAETH
        tristate "Ralink GMAC"
        ---help---
          This driver supports Ralink gigabit ethernet family of
          adapters.

config RAETH_READ_MAC_FROM_MTD
        bool "Read mac adress from mtdflash at boot time"
        depends on RAETH

config RAETH_NAPI
        bool "Use Rx Polling (NAPI)"
        depends on RAETH

choice
	prompt "Network BottomHalves"	
	default RA_NETWORK_TASKLET_BH

	config RA_NETWORK_TASKLET_BH
	bool "Tasklet"

	config RA_NETWORK_WORKQUEUE_BH
	bool "Work Queue"

endchoice

config RAETH_JUMBOFRAME
        bool "Jumbo Frame up to 4K bytes"
        depends on RAETH && !(RALINK_RT3052 || RALINK_RT3352)

config RAETH_CHECKSUM_OFFLOAD
        bool "TCP/UDP/IP checksum offload"
	default y
        depends on RAETH && !RALINK_RT2880

config RAETH_SNMPD
        bool "Support SNMPD in raeth"
	default n

config RAETH_QOS
        bool "QoS Feature"
        depends on RAETH && (RALINK_RT3052 || RALINK_RT3352)

choice
        prompt "QoS Type"
        depends on RAETH_QOS
        default DSCP_QOS_DSCP

config  RAETH_QOS_DSCP_BASED
        bool "DSCP-based"
        depends on RAETH_QOS 

config  RAETH_QOS_PORT_BASED
        bool "Port-based"
        depends on RAETH_QOS

endchoice

choice
        prompt "GMAC is connected to"
        depends on RAETH
        default GE1_RGMII_FORCE_1000

config  GE1_MII_FORCE_100
        bool "MII_FORCE_100 (10/100M Switch)"
        depends on !RALINK_RT3052 && !RALINK_RT3352

config  GE1_MII_AN
        bool "MII_AN (100Phy)"
        depends on !RALINK_RT3052 && !RALINK_RT3352

config  GE1_RVMII_FORCE_100
        bool "RvMII_FORCE_100 (CPU)"
        depends on !RALINK_RT3052 && !RALINK_RT3352

config  GE1_RGMII_FORCE_1000
        bool "RGMII_FORCE_1000 (GigaSW, CPU)"
        depends on !RALINK_RT3052 && !RALINK_RT3352
	select RALINK_SPI

config  GE1_RGMII_AN
        bool "RGMII_AN (GigaPhy)"
        depends on !RALINK_RT3052 && !RALINK_RT3352

config  RT_3052_ESW
        bool "Ralink Embedded Switch(10/100Mbps)"
        depends on RALINK_RT3052 || RALINK_RT3352


endchoice


config	RALINK_VISTA_BASIC
	bool "Vista Basic Logo for IC+ 175C"
        depends on !RALINK_RT3052 && !RALINK_RT3352

config RAETH_HAS_PORT5
        bool "Port 5 Support"
        depends on RAETH && (RALINK_RT3052 || RALINK_RT3352)
choice
        prompt "Target Mode"
        depends on RAETH_HAS_PORT5
	default P5_RGMII_TO_MAC_MODE

	config P5_MAC_TO_PHY_MODE
		bool "Giga_Phy (RGMII)"
	config P5_RGMII_TO_MAC_MODE
		bool "Giga_SW/iNIC (RGMII)"
	config P5_MII_TO_MAC_MODE
		bool "External_CPU (MII_RvMII)"
	config P5_RMII_TO_MAC_MODE
		bool "External_CPU (RvMII_MII)"
endchoice

config  MAC_TO_GIGAPHY_MODE_ADDR
        hex "Phy Address"
	default 0x0 if RT3052_FPGA || RT3352_FPGA
	default 0x1F if !RT3052_FPGA && !RT3352_FPGA
        depends on GE1_MII_AN || GE1_RGMII_AN || P5_MAC_TO_PHY_MODE

config RAETH_GMAC2
        bool "GMAC2 Support"
        depends on RAETH

choice
        prompt "GMAC2 is connected to"
        depends on RAETH_GMAC2
        default GE2_RGMII_AN

config  GE2_MII_FORCE_100
        bool "MII_FORCE_100 (10/100M Switch)"
        depends on !RALINK_RT3052 && !RALINK_RT3352

config  GE2_MII_AN
        bool "MII_AN (100Phy)"
        depends on !RALINK_RT3052 && !RALINK_RT3352

config  GE2_RVMII_FORCE_100
        bool "RvMII_FORCE_100 (CPU)"
        depends on !RALINK_RT3052 && !RALINK_RT3352

config  GE2_RGMII_FORCE_1000
        bool "RGMII_FORCE_1000 (GigaSW, CPU)"
        depends on !RALINK_RT3052 && !RALINK_RT3352
	select RALINK_SPI

config  GE2_RGMII_AN
        bool "RGMII_AN (GigaPhy)"
        depends on !RALINK_RT3052 && !RALINK_RT3352

config  PSEUDO_SUPPORT
	bool "Preudo interface for raeth."
	depends on RAETH

endchoice

config  MAC_TO_GIGAPHY_MODE_ADDR2
        hex "Phy Address"
	default 0x1E
        depends on GE2_MII_AN || GE2_RGMII_AN 

#force 100M
config RAETH_ROUTER
bool
default y if GE1_MII_FORCE_100 || GE2_MII_FORCE_100 || GE1_RVMII_FORCE_100 || GE2_RVMII_FORCE_100

#force 1000M
config MAC_TO_MAC_MODE
bool
default y if GE1_RGMII_FORCE_1000 || GE2_RGMII_FORCE_1000

#AN
config GIGAPHY
bool
default y if GE1_RGMII_AN || GE2_RGMII_AN

#AN
config 100PHY
bool
default y if GE1_MII_AN || GE2_MII_AN

config RAETH_MEMORY_OPTIMIZATION
	bool "Decrease memory usadge. Need for <32Mb RAM devices. More CPU use."
	depends on RAETH
	default n

config RAETH_DHCP_TOUCH
	bool "Send SIGUSR1/2 to dhcpc at media state changed."
	depends on RAETH
	default n
	
```

## linux-2.6.21.x/drivers/net/wireless/rt2860v2/rt2860v2_ap/Kconfig
```kconfig
config RT2860V2_AP
	tristate "Ralink RT2860 802.11n AP support"
	#depends on NET_RADIO 
	
config RT2860V2_AP_V24_DATA_STRUCTURE
	bool
	depends on RT2860V2_AP
	default y
	
config  RT2860V2_AP_LED
	bool "LED Support"
	depends on RT2860V2_AP

config  RT2860V2_AP_WSC
	bool "WSC (WiFi Simple Config)"
	depends on RT2860V2_AP

config  RT2860V2_AP_WIN7PREVIEW
	bool "Win7 Logo Preview"
	depends on RT2860V2_AP_WSC

config  RT2860V2_AP_LLTD
	bool "LLTD (Link Layer Topology Discovery Protocol)"
	depends on RT2860V2_AP

config  RT2860V2_AP_WDS
	bool "WDS"
	depends on RT2860V2_AP

config  RT2860V2_AP_WMM_ACM
	bool "WMM ACM"
	depends on RT2860V2_AP

config  RT2860V2_AP_MBSS
	bool "MBSSID"
	depends on RT2860V2_AP

config  RT2860V2_AP_APCLI
	bool "AP-CLient Support"
	depends on RT2860V2_AP

config  RT2860V2_AP_IGMP_SNOOP
	bool "IGMP snooping"
	depends on RT2860V2_AP

config  RT2860V2_AP_NETIF_BLOCK
	bool "NETIF Block"
	depends on RT2860V2_AP
	help
	Support Net interface block while Tx-Sw queue full

config  RT2860V2_AP_DFS
	bool "DFS"
	depends on RT2860V2_AP
	select RALINK_TIMER
	select RALINK_TIMER_DFS

config  RT2860V2_AP_CARRIER
	bool "Carrier Detect"
	depends on RT2860V2_AP
	select RALINK_TIMER
	select RALINK_TIMER_DFS

config  RT2860V2_AP_DLS
	bool "DLS ((Direct-Link Setup) Support"
	depends on RT2860V2_AP

config  RT2860V2_AP_IDS
	bool "IDS (Intrusion Detection System) Support"
	depends on RT2860V2_AP

config  RT2860V2_RT3XXX_AP_ANTENNA_DIVERSITY
	bool "Antenna Diversity Support"
	depends on RT2860V2_AP

config  RT2860V2_AP_GREENAP
	bool "Green AP mode support"
	depends on RT2860V2_AP

config  RT2860V2_AP_MEMORY_OPTIMIZATION
	bool "Memory Optimization"
	depends on RT2860V2_AP

config  RT2860V2_AP_VIDEO_TURBINE
	bool "Video Turbine support"
	depends on RT2860V2_AP
	default n

config  RA_CLASSIFIER
	bool "Ralink Flow Classifier"
	depends on RT2860V2_AP_VIDEO_TURBINE
	default n

config  RT2860V2_AP_INTELLIGENT_RATE_ADAPTION
        bool "Intelligent Rate Adaption"
	depends on RT2860V2_AP
	depends on RALINK_RT2883 || RALINK_RT3883

config  RT2860V2_AP_TXBF
        bool "Tx Beam Forming Support (Only 3883)"
	depends on RT2860V2_AP
	depends on RALINK_RT2883 || RALINK_RT3883
	default n

#config  RT2860V2_EXT_CHANNEL_LIST
#	bool "Extension Channel List"
#	depends on RT2860V2_AP

#config  RT2860V2_KTHREAD
#	bool "Kernel Thread"
#	depends on RT2860V2_AP

config  RT2860V2_AUTO_CH_SELECT_ENHANCE
	bool "Auto Channel Selection Enhancement"
	depends on RT2860V2_AP

config  RT2860V2_80211N_DRAFT3
	bool "802.11n Draft3"
	depends on RT2860V2_AP

#config  RT2860V2_SINGLE_SKU
#	bool "Single SKU"
#	depends on RT2860V2_AP

config  RT2860V2_MCAST_RATE_SPECIFIC
	bool "User specific tx rate of mcast pkt"
	depends on RT2860V2_AP

#config  RT2860V2_SNMP
#	bool "Net-SNMP Support"
#	depends on RT2860V2_AP

config RALINK_RT2880_AP_DBG
	bool "Debug support for AP mode"
	depends on RT2860V2_AP

config RT2860V2_SET_MAC_FROM_EEPROM
	bool "Read and set MAC from MTD/EEPROM."
	default n
	depends on RT2860V2_AP

config RT2860V2_AP_BRIDGE_FASTPATH
	bool "Bridge wlan2lan operation offload"
	default y
	depends on RT2860V2_AP
```

## linux-2.6.21.x/drivers/net/wireless/rt2860v2/rt2860v2_sta/Kconfig
```kconfig
config RT2860V2_STA
	tristate "Ralink RT2860 802.11n STA support"
	depends on NET_RADIO 

config  RT2860V2_STA_WPA_SUPPLICANT
	bool "WPA Supplicant"
	depends on RT2860V2_STA

config  RT2860V2_STA_DPB
	bool "DPB Support"
	depends on RT2860V2_STA

config  RT2860V2_STA_WMM_ACM
	bool "WMM ACM Support"
	depends on RT2860V2_STA

config  RT2860V2_STA_LED
	bool "LED Support"
	depends on RT2860V2_STA

config  RT2860V2_STA_IDS
        bool "IDS (Intrusion Detection System) Support"
        depends on RT2860V2_STA && !RALINK_RT3052

config  RT2860V2_STA_WSC
	bool "WSC (WiFi Simple Config)"
	depends on RT2860V2_STA

config  RT2860V2_STA_CARRIER
	bool "Carrier Sense Support"
	depends on RT2860V2_STA && !RALINK_RT3052
	select RALINK_TIMER_DFS

config  RT2860V2_STA_DLS
	bool "DLS ((Direct-Link Setup) Support"
	depends on RT2860V2_STA

config  RT2860V2_STA_MESH
	bool "MESH Support"
	depends on RT2860V2_STA

config  RT2860V2_RT3XXX_STA_ANTENNA_DIVERSITY
	bool "Antenna Diversity Support"
	depends on RT2860V2_STA

config  RT2860V2_STA_WAPI
        bool "WAPI Support"
        depends on RT2860V2_STA

config  RT2860V2_STA_VIDEO_TURBINE
	bool "Video Turbine support"
	depends on RT2860V2_STA && !RALINK_RT3052

config  RT2860V2_STA_INTELLIGENT_RATE_ADAPTION
	bool "Intelligent Rate Adaption"
	depends on RT2860V2_STA

config  RT2860V2_STA_TXBF
	bool "TxBF support (Only 2883/3883)"
	depends on RT2860V2_STA

config RALINK_RT2880_STA_DBG
	bool "Debug and ATE support for STA mode"
```

## linux-2.6.21.x/drivers/nvram/Kconfig
```kconfig
menu "ASUS nvram"

config ASUS_NVRAM_API
	tristate "ASUS NVRAM R/W API"
	default m
	---help---
	 ASUS Nvram API

endmenu
```

## linux-2.6.21.x/net/bridge/Kconfig
```kconfig
#
# 802.1d Ethernet Bridging
#

config BRIDGE
	tristate "802.1d Ethernet Bridging"
	select LLC
	---help---
	  If you say Y here, then your Linux box will be able to act as an
	  Ethernet bridge, which means that the different Ethernet segments it
	  is connected to will appear as one Ethernet to the participants.
	  Several such bridges can work together to create even larger
	  networks of Ethernets using the IEEE 802.1 spanning tree algorithm.
	  As this is a standard, Linux bridges will cooperate properly with
	  other third party bridge products.

	  In order to use the Ethernet bridge, you'll need the bridge
	  configuration tools; see <file:Documentation/networking/bridge.txt>
	  for location. Please read the Bridge mini-HOWTO for more
	  information.

	  If you enable iptables support along with the bridge support then you
	  turn your bridge into a bridging IP firewall.
	  iptables will then see the IP packets being bridged, so you need to
	  take this into account when setting up your firewall rules.
	  Enabling arptables support when bridging will let arptables see
	  bridged ARP traffic in the arptables FORWARD chain.

	  To compile this code as a module, choose M here: the module
	  will be called bridge.

	  If unsure, say N.

config BRIDGE_2WAYS_FDB
	bool "2-Ways Forwarding DataBase"
	depends on BRIDGE
	default y
	---help---
	  prevent ARP flooding attack (memory protection code)

config BRIDGE_FORWARD_CTRL
	bool "Forwarding Control"
	depends on BRIDGE
	default y
	---help---
	  This option allows you to enable/disable the forward function of the kernel
	  bridge module by proc_fs /proc/net/br_forward_br0.
	  The default status is 1, indicates bridge forward enable.

	  To disable the function just echo 0 to this node:
	  echo 0 > /proc/net/br_forward_br0

	  and echo 1 to re-enable it:
	  echo 1 > /proc/net/br_forward_br0

config BRIDGE_MAC_AUTO
        bool "Set mac to bridge automaticaly"
        depends on BRIDGE
	default y
        ---help---

config BRIDGE_PORT_FORWARD
	bool "Port forwarding Control"
	depends on BRIDGE
	default y
	---help---
```
